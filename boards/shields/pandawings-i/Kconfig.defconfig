## boards/shields/pandawings-i/Kconfig.defconfig
```kconfig
# Copyright (c) 2022 The ZMK Contributors
# SPDX-License-Identifier: MIT

if SHIELD_PANDAWINGS-I_LEFT

# Name must be less than 16 chars long
config ZMK_KEYBOARD_NAME
    default "PandaWings I"

config ZMK_SPLIT_ROLE_CENTRAL
    default y

endif

if SHIELD_PANDAWINGS-I_DONGLE || SHIELD_PANDAWINGS-I_LEFT || SHIELD_PANDAWINGS-I_RIGHT

config ZMK_SPLIT
    default y

endif
```

## config/west.yml
```yaml
manifest:
  defaults:
    revision: v0.3
  remotes:
    - name: zmkfirmware
      url-base: https://github.com/zmkfirmware
    # Additional modules containing boards/shields/custom code can be listed here as well
    # See https://docs.zephyrproject.org/3.2.0/develop/west/manifest.html#projects
  projects:
    - name: zmk
      remote: zmkfirmware
      import: app/west.yml
    - name: zmk-keyboard-module-pandawings-i
      url: https://github.com/AkytharPandaaa/zmk-keyboard-module-pandawings-i
      path: modules/zmk-keyboard-module-pandawings-i
    - name: zmk-module-caps-word-de
      url: https://github.com/robertwidfen/zmk-module-caps-word-de.git
      path: modules/zmk-module-caps-word-de
    - name: zmk-locales
      url: https://github.com/joelspadin/zmk-locales.git
      path: modules/zmk-locales
  self:
    path: config
```
